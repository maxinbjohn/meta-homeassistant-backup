## conf/layer.conf
```bitbake
# We have a conf and classes directory, append to BBPATH
BBPATH .= ":${LAYERDIR}"

# We have a recipes directory, add to BBFILES
BBFILES += "${LAYERDIR}/recipes*/*/*.bb ${LAYERDIR}/recipes*/*/*.bbappend"

BBFILE_COLLECTIONS += "homeassistant-layer"
BBFILE_PATTERN_homeassistant-layer := "^${LAYERDIR}/"
BBFILE_PRIORITY_homeassistant-layer = "8"

LAYERDEPENDS_homeassistant-layer = "core openembedded-layer"
```
